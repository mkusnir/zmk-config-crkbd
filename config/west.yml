## config/west.yml
```yaml
manifest:
  remotes:
    - name: mkusnir
      url-base: https://github.com/mkusnir
  projects:
    - name: zmk
      remote: mkusnir
      revision: main
      import: app/west.yml
  self:
    path: config
```
